/*
 * Dactyl Manuform 6x6 – nakładka DTS dla lewej połowy (peripheral)
 *
 * Kontroler: nice!nano v2 (nRF52840, kompatybilny z Pro Micro)
 *
 * Okablowanie identyczne jak prawa strona (piny Pro Micro):
 *
 * WIERSZE (row) – diody col→row, pull-down:
 *   Row 0 → D10  Pro Micro 10  (dolny pin – kciuk dół)
 *   Row 1 → D16  Pro Micro 16
 *   Row 2 → D14  Pro Micro 14
 *   Row 3 → D15  Pro Micro 15
 *   Row 4 → D19  Pro Micro 19
 *   Row 5 → D20  Pro Micro 20
 *   Row 6 → D21  Pro Micro 21  (górny pin – F-klawisze)
 *
 * KOLUMNY (col) – active-high:
 *   Col 0 → D9   Pro Micro  9  (zewnętrzny)
 *   Col 1 → D8   Pro Micro  8
 *   Col 2 → D7   Pro Micro  7
 *   Col 3 → D5   Pro Micro  5
 *   Col 4 → D4   Pro Micro  4  (wewnętrzny, zamieniony z D6 w transformacji)
 *   Col 5 → D6   Pro Micro  6
 */

#include "dactyl_manuform_6x6.dtsi"

/ {
    kscan0: kscan {
        compatible = "zmk,kscan-gpio-matrix";
        label = "KSCAN_LEFT";
        diode-direction = "col2row";

        row-gpios
            = <&pro_micro 10 (GPIO_ACTIVE_HIGH | GPIO_PULL_DOWN)>   /* Row 0 – D10 */
            , <&pro_micro 16 (GPIO_ACTIVE_HIGH | GPIO_PULL_DOWN)>   /* Row 1 – D16 */
            , <&pro_micro 14 (GPIO_ACTIVE_HIGH | GPIO_PULL_DOWN)>   /* Row 2 – D14 */
            , <&pro_micro 15 (GPIO_ACTIVE_HIGH | GPIO_PULL_DOWN)>   /* Row 3 – D15 */
            , <&pro_micro 19 (GPIO_ACTIVE_HIGH | GPIO_PULL_DOWN)>   /* Row 4 – D19 */
            , <&pro_micro 20 (GPIO_ACTIVE_HIGH | GPIO_PULL_DOWN)>   /* Row 5 – D20 */
            , <&pro_micro 21 (GPIO_ACTIVE_HIGH | GPIO_PULL_DOWN)>   /* Row 6 – D21 */
            ;

        col-gpios
            = <&pro_micro 9  GPIO_ACTIVE_HIGH>   /* Col 0 – D9  (zewnętrzny) */
            , <&pro_micro 8  GPIO_ACTIVE_HIGH>   /* Col 1 – D8  */
            , <&pro_micro 7  GPIO_ACTIVE_HIGH>   /* Col 2 – D7  */
            , <&pro_micro 5  GPIO_ACTIVE_HIGH>   /* Col 3 – D5  */
            , <&pro_micro 4  GPIO_ACTIVE_HIGH>   /* Col 4 – D4  (wewnętrzny) */
            , <&pro_micro 6  GPIO_ACTIVE_HIGH>   /* Col 5 – D6  */
            ;
    };
};
