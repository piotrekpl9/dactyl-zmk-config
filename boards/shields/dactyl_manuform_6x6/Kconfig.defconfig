## boards/shields/dactyl_manuform_6x6/Kconfig.defconfig
```kconfig
if SHIELD_DACTYL_MANUFORM_6X6_LEFT || SHIELD_DACTYL_MANUFORM_6X6_RIGHT

config ZMK_KEYBOARD_NAME
    default "Dactyl Manuform 6x6"

config ZMK_SPLIT
    default y

if SHIELD_DACTYL_MANUFORM_6X6_LEFT

config ZMK_SPLIT_ROLE_CENTRAL
    default y

endif # SHIELD_DACTYL_MANUFORM_6X6_LEFT

endif # SHIELD_DACTYL_MANUFORM_6X6_LEFT || SHIELD_DACTYL_MANUFORM_6X6_RIGHT
```
